## idk-mine-esp32/sdkconfig.defaults
```kconfig
# ===========================================================================
# idk-nagger-4 : sdkconfig.defaults
# ---------------------------------------------------------------------------
# SPDX-License-Identifier: MIT
# Recommended esp-idf defaults for release builds on ESP32-WROOM-32U.
# Override locally with `idf.py menuconfig` or by editing sdkconfig.
# ===========================================================================

# --- Target ---
CONFIG_IDF_TARGET="esp32"

# --- Compiler & Optimization ---
# Build with -O3 for maximum hashing throughput.
CONFIG_COMPILER_OPTIMIZATION_PERF=y

# --- CPU Frequency ---
# Run at 240 MHz for maximum hash rate.
# To reduce clock for thermal/power tests, change to CONFIG_ESP_DEFAULT_CPU_FREQ_MHZ_160=y
CONFIG_ESP_DEFAULT_CPU_FREQ_MHZ_240=y

# --- Flash ---
CONFIG_ESPTOOLPY_FLASHSIZE_4MB=y
CONFIG_ESPTOOLPY_FLASHFREQ_80M=y
CONFIG_ESPTOOLPY_FLASHMODE_QIO=y

# --- Partition Table ---
CONFIG_PARTITION_TABLE_CUSTOM=y
CONFIG_PARTITION_TABLE_CUSTOM_FILENAME="partition_table.csv"

# --- FreeRTOS ---
CONFIG_FREERTOS_HZ=1000
CONFIG_FREERTOS_UNICORE=n

# --- WiFi ---
CONFIG_ESP_WIFI_SOFTAP_SUPPORT=n

# --- Watchdog ---
CONFIG_ESP_TASK_WDT_TIMEOUT_S=30
CONFIG_ESP_TASK_WDT=y

# --- Log Level (default: WARN for production; change to INFO/DEBUG for dev) ---
CONFIG_LOG_DEFAULT_LEVEL_WARN=y
CONFIG_LOG_MAXIMUM_LEVEL_DEBUG=y

# --- mbedTLS (SHA-256 HW accel) ---
CONFIG_MBEDTLS_HARDWARE_SHA=y
CONFIG_MBEDTLS_HARDWARE_AES=y

# --- LWIP ---
CONFIG_LWIP_SO_RCVBUF=y

# --- System ---
CONFIG_ESP_SYSTEM_PANIC_PRINT_REBOOT=y

# --- NVS ---
CONFIG_NVS_ENCRYPTION=n

# --- PSRAM (auto-detect, optional for LTC scrypt) ---
CONFIG_ESP32_SPIRAM_SUPPORT=y
CONFIG_SPIRAM_USE_MALLOC=y
CONFIG_SPIRAM_MALLOC_ALWAYSINTERNAL=4096
```

## idk-mine/sdkconfig.defaults
```kconfig
# ===========================================================================
# idk-nagger-4 : sdkconfig.defaults
# ---------------------------------------------------------------------------
# SPDX-License-Identifier: MIT
# Recommended esp-idf defaults for release builds on ESP32-WROOM-32U.
# Override locally with `idf.py menuconfig` or by editing sdkconfig.
# ===========================================================================

# --- Target ---
CONFIG_IDF_TARGET="esp32"

# --- Compiler & Optimization ---
# -O3 for maximum hashing throughput
CONFIG_COMPILER_OPTIMIZATION_PERF=y

# --- CPU Frequency ---
# 240 MHz for maximum hash rate
CONFIG_ESP_DEFAULT_CPU_FREQ_MHZ_240=y

# --- Flash ---
CONFIG_ESPTOOLPY_FLASHSIZE_4MB=y
CONFIG_ESPTOOLPY_FLASHFREQ_80M=y
CONFIG_ESPTOOLPY_FLASHMODE_QIO=y

# --- Partition Table ---
CONFIG_PARTITION_TABLE_CUSTOM=y
CONFIG_PARTITION_TABLE_CUSTOM_FILENAME="partition_table.csv"

# --- FreeRTOS ---
CONFIG_FREERTOS_HZ=1000
CONFIG_FREERTOS_UNICORE=n

# --- WiFi ---
CONFIG_ESP_WIFI_SOFTAP_SUPPORT=y

# --- Watchdog ---
CONFIG_ESP_TASK_WDT_TIMEOUT_S=30
CONFIG_ESP_TASK_WDT=y

# --- Log Level ---
CONFIG_LOG_DEFAULT_LEVEL_WARN=y
CONFIG_LOG_MAXIMUM_LEVEL_DEBUG=y

# --- mbedTLS (SHA-256 HW acceleration) ---
CONFIG_MBEDTLS_HARDWARE_SHA=y
CONFIG_MBEDTLS_HARDWARE_AES=y

# --- LWIP ---
CONFIG_LWIP_SO_RCVBUF=y

# --- System ---
CONFIG_ESP_SYSTEM_PANIC_PRINT_REBOOT=y

# --- NVS ---
CONFIG_NVS_ENCRYPTION=n

# --- PSRAM (auto-detect, useful for LTC scrypt) ---
CONFIG_ESP32_SPIRAM_SUPPORT=y
CONFIG_SPIRAM_USE_MALLOC=y
CONFIG_SPIRAM_MALLOC_ALWAYSINTERNAL=4096

# --- HTTP Server (for status endpoint) ---
CONFIG_HTTPD_MAX_REQ_HDR_LEN=1024
```
